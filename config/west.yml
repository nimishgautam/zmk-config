## config/west.yml
```yaml
manifest:
  remotes:
    - name: zmkfirmware
      url-base: https://github.com/zmkfirmware
    - name: urob
      url-base: https://github.com/urob
  projects:
    - name: zmk
      #remote: zmkfirmware
      remote: urob
      revision: mouse-3.2
      #revision: main
      import: app/west.yml
  self:
    path: config
```
